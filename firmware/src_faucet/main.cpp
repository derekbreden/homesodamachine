#include <Arduino.h>
#include <esp_system.h>
#include <Arduino_GFX_Library.h>
#include <lvgl.h>
#include <Preferences.h>
#include <Wire.h>
#include "axs5106l.h"
#include "base_link.h"
#include "fw_version.h"

// Seed logos (172x320 full-bleed center crop, generated by
// tools/png_to_rgb565.py from images/flavor_N.png)
#include "images/flavor0_faucet.h"
#include "images/flavor1_faucet.h"
#include "images/flavor2_faucet.h"
#include "images/flavor3_faucet.h"

// ════════════════════════════════════════════════════════════
//  ESP32-S3 Faucet Display — Flavor Selector + Prime Control
// ════════════════════════════════════════════════════════════
//
// Waveshare ESP32-S3-Touch-LCD-1.47 (172x320 IPS, JD9853 panel,
// AXS5106L capacitive touch) mounted at the end of the gooseneck.
// The selected flavor's logo fills the screen; a tap anywhere toggles
// it. The selection persists in NVS across power cycles.
//
// The logo changes locally on touch-down. J3 then carries that absolute
// selection to the main board, whose persisted value is authoritative;
// this board's NVS value is the immediate boot-logo cache.
// When the enclosure opens prime mode, main board state replaces the logo with
// equal EXIT PRIME and HOLD TO PRIME targets until either display exits.

// ── Theme (matches config display / iOS app) ──
#define THEME_BG  lv_color_hex(0x1a1a2e)
#define COL_CARD   0x242440
#define COL_ACCENT 0xe94560
#define COL_TEXT   0xe8e8f2
#define COL_DIM    0x8888aa
#define COL_GOOD   0x37c98b
#define COL_WARN   0xf0a83c
#define COL_OFF    0x3a3a55

// ── Flavors ──
static const char *FLAVOR_NAMES[2] = {"Flavor 1", "Flavor 2"};
// Every logo a channel can be given. Which one each channel wears is the
// main board's to say — this display renders whichever it publishes.
static const uint16_t *FLAVOR_BITMAPS[FLAVOR_ART_COUNT] = {
    flavor0_faucet, flavor1_faucet, flavor2_faucet, flavor3_faucet,
};
static uint8_t flavorArt[2] = {0, 1};
static lv_img_dsc_t flavorLogos[FLAVOR_ART_COUNT];

static uint8_t activeFlavor = 0;
static Preferences prefs;
static bool flavorStoreOpen = false;

// Persist is debounced off the tap path: NVS writes go to flash (and
// occasionally trigger page GC), so the tap handler only marks dirty.
static bool flavorDirty = false;
static bool flavorPersistError = false;
static unsigned long flavorChangedAt = 0;
static unsigned long flavorPersistAttemptAt = 0;
#define FLAVOR_PERSIST_DELAY_MS 2000

// ── Diagnostics (read via GET_DIAG) ──
static uint32_t maxLoopMs = 0;
static uint32_t toggleCount = 0;

// ── Main-board-owned prime-ready session ──
static PrimeSessionStatePayload primeSession = {};
static bool primeSessionKnown = false;
static bool primeVisible = false;
static bool primePressed = false;
static bool primeStopPending = false;
static bool primeCancelPending = false;
static bool primeLinkLost = false;
static uint32_t primeTokenState = 1;
static uint32_t primeHoldToken = 0;
static uint32_t primeHoldSessionToken = 0;
static uint32_t primeStopRevision = 0;
static bool primeStopRevisionKnown = false;
static uint8_t primeHoldChannel = 0;
static uint32_t primeCancelSessionToken = 0;
static uint8_t primeCancelChannel = 0;
static uint32_t primeElapsedShown = 0;
static uint32_t primeBaseGeneration = 0;
static unsigned long primeElapsedAnchorAt = 0;
static unsigned long primeStateAt = 0;
static unsigned long primeControlSentAt = 0;
static unsigned long primeLastUiAt = 0;

#define PRIME_CONTROL_RETRY_MS 500
#define PRIME_STATE_STALE_MS  1800

// ── Backlight / idle dimming ──
// Full brightness while the appliance considers anyone present, fading to a
// glanceable dim level when the main board says both glasses are done. The
// quiet stretch is counted there, across both, so this head does not dim while
// a hand is at the enclosure. While dimmed, the first tap only wakes the screen
// (consumed in onTap); serial flavor commands wake and apply.
#define BL_FULL_DUTY   255
#define BL_DIM_DUTY    8    // idle glow — soft but clearly visible in a dark room; 0 is off
#define BL_FADE_STEP   4    // duty per loop pass; fade spans (FULL-DIM)/STEP passes

static uint8_t blDuty = BL_FULL_DUTY;
static uint8_t blTarget = BL_FULL_DUTY;
static bool dimmed = false;
static bool idleAsleepWanted = false;   // what the main board last said
static unsigned long lastInputTime = 0;

// ── Pin assignments (fixed by Waveshare ESP32-S3-Touch-LCD-1.47) ──

// Display SPI (JD9853, 172x320, driven via the ST7789 command set)
#define LCD_DC    45
#define LCD_CS    21
#define LCD_SCK   38
#define LCD_MOSI  39
#define LCD_RST   40
#define LCD_BL    46

// Touch (AXS5106L)
#define TOUCH_SDA 42
#define TOUCH_SCL 41
#define TOUCH_RST 47
#define TOUCH_INT 48

#define SCREEN_W  172
#define SCREEN_H  320
#define ROTATION  0  // USB connector points down on the faucet mount

// ── Hardware objects ──
Arduino_DataBus *bus = new Arduino_ESP32SPI(
    LCD_DC, LCD_CS, LCD_SCK, LCD_MOSI, GFX_NOT_DEFINED, FSPI, true);

// The JD9853 speaks the ST7789 command set for addressing; panel-specific
// registers are programmed in lcdRegInit() after begin().
Arduino_GFX *gfx = new Arduino_ST7789(
    bus, LCD_RST, 0 /* rotation */, false /* IPS */,
    SCREEN_W, SCREEN_H,
    34 /* col offset 1 */, 0 /* row offset 1 */,
    34 /* col offset 2 */, 0 /* row offset 2 */);

AXS5106L touch(TOUCH_RST, TOUCH_INT);

// ── LVGL display buffer ──
static lv_disp_draw_buf_t draw_buf;
static lv_color_t *lvgl_buf;
#define LVGL_BUF_LINES 40

// ── UI objects ──
static lv_obj_t *logoImg;
static lv_obj_t *primeLayer;
static lv_obj_t *otaLayer, *otaTitle, *otaPct;
static lv_obj_t *primeExitBtn, *primeHoldBtn;
static lv_obj_t *primeExitLbl, *primeHoldLbl, *primeStatusLbl;
static lv_indev_t *touchInput = nullptr;

// ════════════════════════════════════════════════════════════
//  JD9853 panel init (register sequence published by Waveshare)
// ════════════════════════════════════════════════════════════

static void lcdRegInit() {
  static const uint8_t init_operations[] = {
      BEGIN_WRITE,
      WRITE_COMMAND_8, 0x11,  // Sleep out
      END_WRITE,
      DELAY, 120,

      BEGIN_WRITE,
      WRITE_C8_D16, 0xDF, 0x98, 0x53,
      WRITE_C8_D8, 0xB2, 0x23,

      WRITE_COMMAND_8, 0xB7,
      WRITE_BYTES, 4,
      0x00, 0x47, 0x00, 0x6F,

      WRITE_COMMAND_8, 0xBB,
      WRITE_BYTES, 6,
      0x1C, 0x1A, 0x55, 0x73, 0x63, 0xF0,

      WRITE_C8_D16, 0xC0, 0x44, 0xA4,
      WRITE_C8_D8, 0xC1, 0x16,

      WRITE_COMMAND_8, 0xC3,
      WRITE_BYTES, 8,
      0x7D, 0x07, 0x14, 0x06, 0xCF, 0x71, 0x72, 0x77,

      WRITE_COMMAND_8, 0xC4,
      WRITE_BYTES, 12,
      0x00, 0x00, 0xA0, 0x79, 0x0B, 0x0A, 0x16, 0x79, 0x0B, 0x0A, 0x16, 0x82,

      WRITE_COMMAND_8, 0xC8,
      WRITE_BYTES, 32,
      0x3F, 0x32, 0x29, 0x29, 0x27, 0x2B, 0x27, 0x28, 0x28, 0x26, 0x25, 0x17,
      0x12, 0x0D, 0x04, 0x00, 0x3F, 0x32, 0x29, 0x29, 0x27, 0x2B, 0x27, 0x28,
      0x28, 0x26, 0x25, 0x17, 0x12, 0x0D, 0x04, 0x00,

      WRITE_COMMAND_8, 0xD0,
      WRITE_BYTES, 5,
      0x04, 0x06, 0x6B, 0x0F, 0x00,

      WRITE_C8_D16, 0xD7, 0x00, 0x30,
      WRITE_C8_D8, 0xE6, 0x14,
      WRITE_C8_D8, 0xDE, 0x01,

      WRITE_COMMAND_8, 0xB7,
      WRITE_BYTES, 5,
      0x03, 0x13, 0xEF, 0x35, 0x35,

      WRITE_COMMAND_8, 0xC1,
      WRITE_BYTES, 3,
      0x14, 0x15, 0xC0,

      WRITE_C8_D16, 0xC2, 0x06, 0x3A,
      WRITE_C8_D16, 0xC4, 0x72, 0x12,
      WRITE_C8_D8, 0xBE, 0x00,
      WRITE_C8_D8, 0xDE, 0x02,

      WRITE_COMMAND_8, 0xE5,
      WRITE_BYTES, 3,
      0x00, 0x02, 0x00,

      WRITE_COMMAND_8, 0xE5,
      WRITE_BYTES, 3,
      0x01, 0x02, 0x00,

      WRITE_C8_D8, 0xDE, 0x00,
      WRITE_C8_D8, 0x35, 0x00,  // Tearing effect on
      WRITE_C8_D8, 0x3A, 0x05,  // RGB565

      WRITE_COMMAND_8, 0x2A,
      WRITE_BYTES, 4,
      0x00, 0x22, 0x00, 0xCD,

      WRITE_COMMAND_8, 0x2B,
      WRITE_BYTES, 4,
      0x00, 0x00, 0x01, 0x3F,

      WRITE_C8_D8, 0xDE, 0x02,

      WRITE_COMMAND_8, 0xE5,
      WRITE_BYTES, 3,
      0x00, 0x02, 0x00,

      WRITE_C8_D8, 0xDE, 0x00,
      WRITE_C8_D8, 0x36, 0x00,  // MADCTL
      WRITE_COMMAND_8, 0x21,    // Inversion on
      END_WRITE,

      DELAY, 10,

      BEGIN_WRITE,
      WRITE_COMMAND_8, 0x29,  // Display on
      END_WRITE,
  };
  bus->batchOperation(init_operations, sizeof(init_operations));
}

// ════════════════════════════════════════════════════════════
//  LVGL callbacks
// ════════════════════════════════════════════════════════════

static void lvglFlush(lv_disp_drv_t *disp, const lv_area_t *area, lv_color_t *color_p) {
  uint32_t w = area->x2 - area->x1 + 1;
  uint32_t h = area->y2 - area->y1 + 1;
  gfx->draw16bitRGBBitmap(area->x1, area->y1, (uint16_t *)&color_p->full, w, h);
  lv_disp_flush_ready(disp);
}

static void touchpadRead(lv_indev_drv_t *drv, lv_indev_data_t *data) {
  uint16_t x, y;
  if (touch.getTouch(&x, &y)) {
    lastInputTime = millis();
    data->point.x = x;
    data->point.y = y;
    data->state = LV_INDEV_STATE_PRESSED;
  } else {
    data->state = LV_INDEV_STATE_RELEASED;
  }
}

// ════════════════════════════════════════════════════════════
//  Flavor state
// ════════════════════════════════════════════════════════════

static void applyFlavorUi() {
  lv_img_set_src(logoImg, &flavorLogos[flavorArt[activeFlavor & 1]]);
}

// The main board's resulting truth for the pair. Rendered immediately when the
// channel on screen is one whose logo moved.
void faucetApplyFlavorArt(const uint8_t art[2]) {
  bool moved = false;
  for (uint8_t i = 0; i < 2; i++) {
    if (art[i] < FLAVOR_ART_COUNT && flavorArt[i] != art[i]) {
      flavorArt[i] = art[i];
      moved = true;
    }
  }
  if (moved && logoImg) applyFlavorUi();
}

static void wakeBacklight() {
  // The main board is being told a finger landed. Take the awake state now, or
  // the loop re-dims against the sleep it last published before the answer.
  idleAsleepWanted = false;
  dimmed = false;
  blDuty = blTarget = BL_FULL_DUTY;
  ledcWrite(LCD_BL, blDuty);
  Serial.println("Backlight wake");
}

static void applyFlavor(uint8_t f) {
  if (f > 1 || f == activeFlavor) return;
  lastInputTime = millis();
  if (dimmed) wakeBacklight();
  activeFlavor = f;
  applyFlavorUi();
  flavorDirty = true;
  flavorPersistError = !flavorStoreOpen;
  flavorChangedAt = millis();
}

static void selectFlavorLocally(uint8_t f) {
  if (f > 1 || f == activeFlavor) return;
  applyFlavor(f);
  toggleCount++;
  Serial.printf("Flavor -> %d (%s)\n", activeFlavor + 1, FLAVOR_NAMES[activeFlavor]);
  baseLinkSelect(activeFlavor, true);
}

static void acceptBaseFlavor(uint8_t f) {
  if (f > 1 || f == activeFlavor) return;
  applyFlavor(f);
  Serial.printf("Main board flavor -> %d (%s)\n",
                activeFlavor + 1, FLAVOR_NAMES[activeFlavor]);
}

static void onTap(lv_event_t *e) {
  if (dimmed) {  // a tap on a dimmed screen only wakes it
    lastInputTime = millis();
    wakeBacklight();
    baseLinkTouched();
    return;
  }
  const uint8_t before = activeFlavor;
  selectFlavorLocally(activeFlavor ^ 1);
  // A tap that changed nothing sent nothing, and is still a finger.
  if (activeFlavor == before) baseLinkTouched();
}

// ════════════════════════════════════════════════════════════
//  Shared prime-ready mode
// ════════════════════════════════════════════════════════════

static uint32_t nextPrimeToken() {
  primeTokenState += 0x9E3779B9u;
  if (primeTokenState == 0) ++primeTokenState;
  return primeTokenState;
}

static void primeMarkStopPending() {
  if (primeStopPending) return;
  primeStopPending = true;
  primeStopRevisionKnown = primeSessionKnown && primeHoldSessionToken != 0 &&
                           primeSession.sessionToken == primeHoldSessionToken;
  primeStopRevision = primeStopRevisionKnown ? primeSession.revision : 0;
}

static void primeClearStopPending() {
  primeStopPending = false;
  primeStopRevisionKnown = false;
  primeStopRevision = 0;
}

static uint32_t displayedPrimeElapsed() {
  uint32_t elapsed = primeSession.elapsedMs;
  if (primeSession.phase == PRIME_SESSION_RUNNING && !primeLinkLost) {
    elapsed += millis() - primeElapsedAnchorAt;
    if (elapsed < primeElapsedShown) elapsed = primeElapsedShown;
  }
  if (elapsed > PRIME_MAX_MS) elapsed = PRIME_MAX_MS;
  return elapsed;
}

static const char *primeOutcomeName(uint8_t outcome) {
  switch (outcome) {
    case PRIME_OUTCOME_STOPPED:       return "STOPPED";
    case PRIME_OUTCOME_TIMEOUT:       return "HOLD LOST";
    case PRIME_OUTCOME_LIMIT:         return "60 S LIMIT";
    case PRIME_OUTCOME_REFUSED:       return "REFUSED";
    case PRIME_OUTCOME_CANCELED:      return "CANCELED";
    case PRIME_OUTCOME_LEASE_EXPIRED: return "SESSION LOST";
    default:                          return "READY";
  }
}

static void refreshPrimeStatus(bool force = false) {
  if (!primeVisible || !primeStatusLbl) return;

  const uint32_t elapsed = displayedPrimeElapsed();
  if (!force && primeSession.phase == PRIME_SESSION_RUNNING &&
      elapsed / 100 == primeElapsedShown / 100) return;
  primeElapsedShown = elapsed;

  char status[40];
  if (primeLinkLost) {
    snprintf(status, sizeof(status), "FLAVOR %u  |  LINK LOST", primeSession.channel + 1);
  } else if (primeCancelPending) {
    snprintf(status, sizeof(status), "ENDING ON BOTH DISPLAYS");
  } else if (primeStopPending) {
    snprintf(status, sizeof(status), "FLAVOR %u  |  STOPPING", primeSession.channel + 1);
  } else if (primeSession.phase == PRIME_SESSION_RUNNING) {
    snprintf(status, sizeof(status), "%s  |  %lu.%lu s",
             primeSession.owner == PRIME_OWNER_FAUCET ? "HERE" : "ENCLOSURE",
             (unsigned long)elapsed / 1000,
             ((unsigned long)elapsed % 1000) / 100);
  } else if (primeSession.outcome != PRIME_OUTCOME_NONE) {
    snprintf(status, sizeof(status), "%s  |  %lu.%lu s",
             primeOutcomeName(primeSession.outcome),
             (unsigned long)elapsed / 1000,
             ((unsigned long)elapsed % 1000) / 100);
  } else {
    snprintf(status, sizeof(status), "FLAVOR %u", primeSession.channel + 1);
  }
  lv_label_set_text(primeStatusLbl, status);
}

static void renderPrime(bool force = false) {
  if (!primeVisible || !primeHoldLbl || !primeHoldBtn) return;
  static uint8_t shownPhase = 0xFF;
  static uint8_t shownOwner = 0xFF;
  static uint8_t shownOutcome = 0xFF;
  static bool shownPressed = false;
  static bool shownStop = false;
  static bool shownCancel = false;
  static bool shownLost = false;

  const bool changed = force || shownPhase != primeSession.phase ||
                       shownOwner != primeSession.owner ||
                       shownOutcome != primeSession.outcome ||
                       shownPressed != primePressed ||
                       shownStop != primeStopPending ||
                       shownCancel != primeCancelPending ||
                       shownLost != primeLinkLost;
  if (!changed) return;
  shownPhase = primeSession.phase;
  shownOwner = primeSession.owner;
  shownOutcome = primeSession.outcome;
  shownPressed = primePressed;
  shownStop = primeStopPending;
  shownCancel = primeCancelPending;
  shownLost = primeLinkLost;

  if (primeCancelPending) {
    lv_label_set_text(primeHoldLbl, "EXITING PRIME");
    lv_obj_set_style_bg_color(primeHoldBtn, lv_color_hex(COL_OFF), 0);
  } else if (primeLinkLost) {
    lv_label_set_text(primeHoldLbl, "RECONNECTING");
    lv_obj_set_style_bg_color(primeHoldBtn, lv_color_hex(COL_OFF), 0);
  } else if (primeStopPending) {
    lv_label_set_text(primeHoldLbl, "STOPPING");
    lv_obj_set_style_bg_color(primeHoldBtn, lv_color_hex(COL_OFF), 0);
  } else if (primeSession.phase == PRIME_SESSION_RUNNING) {
    lv_label_set_text(primeHoldLbl, "PRIMING");
    lv_obj_set_style_bg_color(primeHoldBtn, lv_color_hex(COL_GOOD), 0);
  } else if (primePressed) {
    lv_label_set_text(primeHoldLbl, "STARTING");
    lv_obj_set_style_bg_color(primeHoldBtn, lv_color_hex(COL_ACCENT), 0);
  } else {
    lv_label_set_text(primeHoldLbl, "HOLD TO PRIME");
    lv_obj_set_style_bg_color(primeHoldBtn, lv_color_hex(COL_ACCENT), 0);
  }
  // LV_STATE_PRESSED otherwise hides the authoritative green state beneath
  // the generic touch color for the entire time the user's finger is down.
  const bool blocked = primeCancelPending || primeLinkLost || primeStopPending;
  lv_obj_set_style_bg_color(
      primeHoldBtn,
      lv_color_hex(blocked ? COL_OFF
                   : primeSession.phase == PRIME_SESSION_RUNNING ? COL_GOOD : COL_CARD),
      LV_STATE_PRESSED);
  refreshPrimeStatus(true);
}

static void setPrimeVisible(bool visible) {
  if (!primeLayer || visible == primeVisible) return;
  // Main board state can replace or uncover the whole screen between two
  // touch samples. Keep an already-resting finger from becoming a fresh press
  // on whichever target just appeared underneath it.
  if (touchInput) lv_indev_wait_release(touchInput);
  primeVisible = visible;
  if (visible) {
    lv_obj_clear_flag(primeLayer, LV_OBJ_FLAG_HIDDEN);
    renderPrime(true);
  } else {
    lv_obj_add_flag(primeLayer, LV_OBJ_FLAG_HIDDEN);
  }
}

// An image is arriving over J3. esp_ota_write stalls this board for whole
// seconds at a time and LVGL only runs between chunks, so the panel is painted
// once here and then only its percentage changes — a screen that says what is
// happening rather than one that looks hung.
void faucetApplyOta(bool active, uint8_t percent) {
  if (!otaLayer) {
    otaLayer = lv_obj_create(lv_scr_act());
    lv_obj_remove_style_all(otaLayer);
    lv_obj_set_pos(otaLayer, 0, 0);
    lv_obj_set_size(otaLayer, SCREEN_W, SCREEN_H);
    lv_obj_set_style_bg_color(otaLayer, THEME_BG, 0);
    lv_obj_set_style_bg_opa(otaLayer, LV_OPA_COVER, 0);
    lv_obj_clear_flag(otaLayer, LV_OBJ_FLAG_SCROLLABLE);

    otaTitle = lv_label_create(otaLayer);
    lv_label_set_text(otaTitle, "UPDATING");
    lv_obj_set_style_text_font(otaTitle, &lv_font_montserrat_20, 0);
    lv_obj_set_style_text_color(otaTitle, lv_color_hex(COL_TEXT), 0);
    lv_obj_align(otaTitle, LV_ALIGN_CENTER, 0, -28);

    otaPct = lv_label_create(otaLayer);
    lv_obj_set_style_text_font(otaPct, &lv_font_montserrat_20, 0);
    lv_obj_set_style_text_color(otaPct, lv_color_hex(COL_ACCENT), 0);
    lv_obj_align(otaPct, LV_ALIGN_CENTER, 0, 12);
  }

  if (!active) {
    lv_obj_add_flag(otaLayer, LV_OBJ_FLAG_HIDDEN);
    return;
  }

  // Nothing dims or sleeps mid-transfer, and the screen must be lit to be read.
  lastInputTime = millis();
  wakeBacklight();
  lv_label_set_text_fmt(otaPct, "%u%%", (unsigned)percent);
  lv_obj_move_foreground(otaLayer);
  lv_obj_clear_flag(otaLayer, LV_OBJ_FLAG_HIDDEN);
  lv_timer_handler();
}

void faucetApplyIdle(bool asleep) {
  idleAsleepWanted = asleep;
  if (!asleep && dimmed) {
    lastInputTime = millis();
    wakeBacklight();
  }
}

static bool primeWakeOnly() {
  if (!dimmed) return false;
  lastInputTime = millis();
  wakeBacklight();
  // Waking consumes the whole physical touch, even if the finger slides from
  // one half of the screen into the other before it lifts.
  if (touchInput) lv_indev_wait_release(touchInput);
  return true;
}

static void onPrimeExit(lv_event_t *e) {
  (void)e;
  if (primeWakeOnly() || !primeVisible || primeSession.phase == PRIME_SESSION_OFF) return;
  lastInputTime = millis();
  primePressed = false;
  primeClearStopPending();
  primeCancelPending = true;
  primeCancelChannel = primeSession.channel;
  primeCancelSessionToken = primeSession.sessionToken;
  baseLinkPrimeCancel(primeCancelChannel, primeCancelSessionToken);
  primeHoldToken = 0;
  primeHoldSessionToken = 0;
  primeControlSentAt = millis();
  renderPrime(true);
}

static void onPrimeHold(lv_event_t *e) {
  const lv_event_code_t code = lv_event_get_code(e);
  if (code == LV_EVENT_PRESSED) {
    if (primeWakeOnly() || !primeVisible || primeLinkLost || primeCancelPending ||
        primeStopPending ||
        primeSession.phase != PRIME_SESSION_READY) return;
    lastInputTime = millis();
    primePressed = true;
    primeClearStopPending();
    primeHoldToken = nextPrimeToken();
    primeHoldChannel = primeSession.channel;
    primeHoldSessionToken = primeSession.sessionToken;
    baseLinkPrimeHoldStart(primeHoldChannel, primeHoldSessionToken, primeHoldToken);
    primeControlSentAt = millis();
    renderPrime(true);
  } else if (code == LV_EVENT_RELEASED || code == LV_EVENT_PRESS_LOST) {
    if (primePressed) {
      primePressed = false;
      primeMarkStopPending();
      baseLinkPrimeHoldStop(primeHoldChannel, primeHoldSessionToken, primeHoldToken);
      primeControlSentAt = millis();
      renderPrime(true);
    }
    if (code == LV_EVENT_PRESS_LOST) {
      // LVGL otherwise re-hit-tests this still-pressed sample and can deliver a
      // fresh PRESSED to EXIT PRIME directly above the pad.
      lv_indev_t *indev = lv_indev_get_act();
      if (indev) {
        lv_indev_wait_release(indev);
        lv_indev_reset(indev, nullptr);
      }
    }
  }
}

static void acceptBasePrime(const PrimeSessionStatePayload &state, uint32_t generation) {
  if (state.phase > PRIME_SESSION_RUNNING || state.channel > PUMP_CHANNEL_B ||
      state.owner > PRIME_OWNER_FAUCET || state.outcome > PRIME_OUTCOME_LEASE_EXPIRED) return;

  if (generation != primeBaseGeneration) {
    // TinyProto's connection epoch is the faucet's proof that a lower revision
    // can belong to a rebooted main board rather than an out-of-order frame.
    primeBaseGeneration = generation;
    if (primePressed) {
      primePressed = false;
      // Capture the old same-session revision before forgetting the previous
      // connection epoch, so a later READY/H2 can supersede a lost STOP/H1.
      primeMarkStopPending();
    }
    primeSessionKnown = false;
  }

  if (primeSessionKnown) {
    const int32_t revisionDelta = (int32_t)(state.revision - primeSession.revision);
    if (revisionDelta < 0) return;
    if (revisionDelta == 0) {
      primeStateAt = millis();
      const bool recovered = primeLinkLost;
      primeLinkLost = false;
      if (state.phase != PRIME_SESSION_RUNNING ||
          primeSession.phase != PRIME_SESSION_RUNNING ||
          state.sessionToken != primeSession.sessionToken ||
          state.holdToken != primeSession.holdToken ||
          state.owner != primeSession.owner || state.elapsedMs < primeSession.elapsedMs) {
        if (recovered) renderPrime(true);
        return;
      }
      primeSession.elapsedMs = state.elapsedMs;
      primeElapsedAnchorAt = millis();
      if (recovered) renderPrime(true);
      return;
    }
  }

  // A retry belongs to the exact session in which the physical gesture began.
  // If OFF was coalesced and the next accepted snapshot is already a new
  // session, never retarget an old EXIT/hold to that new main board token.
  const bool cancelRetargeted = primeCancelPending &&
                                state.sessionToken != primeCancelSessionToken;
  const bool holdRetargeted = (primePressed || primeStopPending) &&
                              state.sessionToken != primeHoldSessionToken;
  if (cancelRetargeted || holdRetargeted) {
    baseLinkPrimeDiscard();
    if (cancelRetargeted) {
      primeCancelPending = false;
      primeCancelSessionToken = 0;
    }
    if (holdRetargeted) {
      primePressed = false;
      primeClearStopPending();
      primeHoldToken = 0;
      primeHoldSessionToken = 0;
    }
  }

  const bool wasKnown = primeSessionKnown;
  const PrimeSessionStatePayload previous = primeSession;
  primeSession = state;
  primeSessionKnown = true;
  primeStateAt = primeElapsedAnchorAt = millis();
  primeLinkLost = false;

  if (state.phase == PRIME_SESSION_OFF) {
    primePressed = false;
    primeClearStopPending();
    primeCancelPending = false;
    primeHoldToken = 0;
    primeHoldSessionToken = 0;
    primeCancelSessionToken = 0;
    primeElapsedShown = state.elapsedMs;
    setPrimeVisible(false);
    return;
  }

  const bool entering = !wasKnown || previous.phase == PRIME_SESSION_OFF ||
                        previous.sessionToken != state.sessionToken;
  const bool runStarted = state.phase == PRIME_SESSION_RUNNING &&
                          (!wasKnown || previous.phase != PRIME_SESSION_RUNNING ||
                           previous.holdToken != state.holdToken);
  const bool runEnded = wasKnown && previous.phase == PRIME_SESSION_RUNNING &&
                        state.phase != PRIME_SESSION_RUNNING;
  if (entering || runStarted || runEnded) {
    lastInputTime = millis();
    if (dimmed) wakeBacklight();
  }
  setPrimeVisible(true);

  if (state.phase == PRIME_SESSION_RUNNING) {
    const bool ourRun = state.owner == PRIME_OWNER_FAUCET &&
                        state.sessionToken == primeHoldSessionToken &&
                        state.holdToken == primeHoldToken;
    if (primePressed && !ourRun) {
      // The enclosure won a simultaneous press. Retire any unsent local START
      // with an absolute STOP before dropping the local held state.
      primePressed = false;
      primeMarkStopPending();
      baseLinkPrimeHoldStop(primeHoldChannel, primeHoldSessionToken, primeHoldToken);
      primeControlSentAt = millis();
    }
  } else {
    if (state.sessionToken == primeHoldSessionToken &&
        state.holdToken == primeHoldToken && state.outcome != PRIME_OUTCOME_NONE) {
      primePressed = false;
      primeClearStopPending();
      primeHoldToken = 0;
      primeHoldSessionToken = 0;
    }
  }

  primeElapsedShown = state.elapsedMs;
  renderPrime(true);
}

static void primeService(const BaseLinkStatus &link) {
  if (!primeVisible) return;
  const unsigned long now = millis();

  const bool stale = !link.connected || !primeStateAt ||
                     now - primeStateAt >= PRIME_STATE_STALE_MS;
  if (stale) {
    if (primePressed) {
      primePressed = false;
      primeMarkStopPending();
      baseLinkPrimeHoldStop(primeHoldChannel, primeHoldSessionToken, primeHoldToken);
      primeControlSentAt = now;
    }
    if (!primeLinkLost) {
      primeLinkLost = true;
      lastInputTime = now;
      renderPrime(true);
    }
  }

  if (!link.connected) return;
  if (primeCancelPending) {
    if (now - primeControlSentAt >= PRIME_CONTROL_RETRY_MS) {
      baseLinkPrimeCancel(primeCancelChannel, primeCancelSessionToken);
      primeControlSentAt = now;
    }
    return;
  }

  if (primeStopPending) {
    const bool sameRun = primeSession.phase == PRIME_SESSION_RUNNING &&
                         primeSession.owner == PRIME_OWNER_FAUCET &&
                         primeSession.sessionToken == primeHoldSessionToken &&
                         primeSession.holdToken == primeHoldToken;
    const bool otherRun = primeSession.phase == PRIME_SESSION_RUNNING && !sameRun;
    const bool terminalReady = primeSession.phase == PRIME_SESSION_READY &&
                               primeSession.sessionToken == primeHoldSessionToken &&
                               primeSession.holdToken == primeHoldToken &&
                               primeSession.outcome >= PRIME_OUTCOME_STOPPED &&
                               primeSession.outcome <= PRIME_OUTCOME_REFUSED;
    // A newer H2 state in this same session supersedes a lost terminal reply
    // for H1 just as conclusively as receiving READY/H1 itself.
    const bool superseded = primeStopRevisionKnown &&
                            primeStateSupersedesPendingStop(
                                primeSession, primeHoldSessionToken,
                                primeHoldToken, PRIME_OWNER_FAUCET,
                                primeStopRevision);
    if (otherRun || terminalReady || superseded) {
      primeClearStopPending();
      primeHoldToken = 0;
      primeHoldSessionToken = 0;
      renderPrime(true);
    } else if (now - primeControlSentAt >= PRIME_CONTROL_RETRY_MS) {
      baseLinkPrimeHoldStop(primeHoldChannel, primeHoldSessionToken, primeHoldToken);
      primeControlSentAt = now;
    }
    return;
  }

  if (primePressed && !primeLinkLost && now - primeControlSentAt >= PRIME_TICK_MS) {
    const bool acknowledged = primeSession.phase == PRIME_SESSION_RUNNING &&
                              primeSession.owner == PRIME_OWNER_FAUCET &&
                              primeSession.sessionToken == primeHoldSessionToken &&
                              primeSession.holdToken == primeHoldToken;
    if (acknowledged) {
      baseLinkPrimeHoldTick(primeHoldChannel, primeHoldSessionToken, primeHoldToken);
    } else {
      baseLinkPrimeHoldStart(primeHoldChannel, primeHoldSessionToken, primeHoldToken);
    }
    primeControlSentAt = now;
  }

  if (primeSession.phase == PRIME_SESSION_RUNNING && !primeLinkLost &&
      now - primeLastUiAt >= 100) {
    primeLastUiAt = now;
    refreshPrimeStatus();
  }
}

// ════════════════════════════════════════════════════════════
//  UI
// ════════════════════════════════════════════════════════════

static void buildUi() {
  for (uint8_t i = 0; i < FLAVOR_ART_COUNT; i++) {
    flavorLogos[i].header.cf = LV_IMG_CF_TRUE_COLOR;
    flavorLogos[i].header.always_zero = 0;
    flavorLogos[i].header.w = SCREEN_W;
    flavorLogos[i].header.h = SCREEN_H;
    flavorLogos[i].data_size = SCREEN_W * SCREEN_H * sizeof(uint16_t);
    flavorLogos[i].data = (const uint8_t *)FLAVOR_BITMAPS[i];
  }

  lv_obj_t *scr = lv_scr_act();
  lv_obj_set_style_bg_color(scr, THEME_BG, 0);
  lv_obj_clear_flag(scr, LV_OBJ_FLAG_SCROLLABLE);

  // Flavor logo fills the panel
  logoImg = lv_img_create(scr);
  lv_obj_align(logoImg, LV_ALIGN_CENTER, 0, 0);

  // Full-screen tap target on top. Strip all theme styles — the theme's
  // pressed-state transition would otherwise animate this (invisible)
  // object on every tap, forcing extra full-screen redraws.
  lv_obj_t *overlay = lv_obj_create(scr);
  lv_obj_remove_style_all(overlay);
  lv_obj_set_size(overlay, LV_PCT(100), LV_PCT(100));
  lv_obj_clear_flag(overlay, LV_OBJ_FLAG_SCROLLABLE);
  lv_obj_add_flag(overlay, LV_OBJ_FLAG_CLICKABLE);
  lv_obj_add_event_cb(overlay, onTap, LV_EVENT_PRESSED, NULL);

  // Prime-ready replaces the logo with two literal, equal-height targets.
  // It is built once and hidden so entering service mode performs no heap
  // allocation and cannot add latency to the ordinary flavor tap path.
  primeLayer = lv_obj_create(scr);
  lv_obj_remove_style_all(primeLayer);
  lv_obj_set_pos(primeLayer, 0, 0);
  lv_obj_set_size(primeLayer, SCREEN_W, SCREEN_H);
  lv_obj_set_style_bg_color(primeLayer, THEME_BG, 0);
  lv_obj_set_style_bg_opa(primeLayer, LV_OPA_COVER, 0);
  lv_obj_clear_flag(primeLayer, LV_OBJ_FLAG_SCROLLABLE);

  primeExitBtn = lv_btn_create(primeLayer);
  lv_obj_remove_style_all(primeExitBtn);
  lv_obj_set_pos(primeExitBtn, 0, 0);
  lv_obj_set_size(primeExitBtn, SCREEN_W, SCREEN_H / 2);
  lv_obj_set_style_bg_color(primeExitBtn, lv_color_hex(COL_CARD), 0);
  lv_obj_set_style_bg_opa(primeExitBtn, LV_OPA_COVER, 0);
  lv_obj_set_style_bg_color(primeExitBtn, lv_color_hex(COL_OFF), LV_STATE_PRESSED);
  lv_obj_add_flag(primeExitBtn, LV_OBJ_FLAG_CLICKABLE | LV_OBJ_FLAG_PRESS_LOCK);
  lv_obj_add_event_cb(primeExitBtn, onPrimeExit, LV_EVENT_PRESSED, NULL);
  primeExitLbl = lv_label_create(primeExitBtn);
  lv_label_set_text(primeExitLbl, "EXIT PRIME");
  lv_obj_set_style_text_font(primeExitLbl, &lv_font_montserrat_20, 0);
  lv_obj_set_style_text_color(primeExitLbl, lv_color_hex(COL_TEXT), 0);
  lv_obj_center(primeExitLbl);

  primeHoldBtn = lv_btn_create(primeLayer);
  lv_obj_remove_style_all(primeHoldBtn);
  lv_obj_set_pos(primeHoldBtn, 0, SCREEN_H / 2);
  lv_obj_set_size(primeHoldBtn, SCREEN_W, SCREEN_H / 2);
  lv_obj_set_style_bg_color(primeHoldBtn, lv_color_hex(COL_ACCENT), 0);
  lv_obj_set_style_bg_opa(primeHoldBtn, LV_OPA_COVER, 0);
  lv_obj_set_style_bg_color(primeHoldBtn, lv_color_hex(COL_CARD), LV_STATE_PRESSED);
  lv_obj_add_flag(primeHoldBtn, LV_OBJ_FLAG_CLICKABLE);
  lv_obj_clear_flag(primeHoldBtn, LV_OBJ_FLAG_PRESS_LOCK);
  lv_obj_add_event_cb(primeHoldBtn, onPrimeHold, LV_EVENT_ALL, NULL);

  primeHoldLbl = lv_label_create(primeHoldBtn);
  lv_label_set_text(primeHoldLbl, "HOLD TO PRIME");
  lv_obj_set_style_text_font(primeHoldLbl, &lv_font_montserrat_20, 0);
  lv_obj_set_style_text_color(primeHoldLbl, lv_color_hex(COL_TEXT), 0);
  lv_obj_align(primeHoldLbl, LV_ALIGN_CENTER, 0, -18);

  primeStatusLbl = lv_label_create(primeHoldBtn);
  lv_label_set_text(primeStatusLbl, "FLAVOR 1");
  lv_obj_set_width(primeStatusLbl, SCREEN_W - 12);
  lv_obj_set_style_text_align(primeStatusLbl, LV_TEXT_ALIGN_CENTER, 0);
  lv_obj_set_style_text_font(primeStatusLbl, &lv_font_montserrat_14, 0);
  lv_obj_set_style_text_color(primeStatusLbl, lv_color_hex(COL_TEXT), 0);
  lv_obj_align(primeStatusLbl, LV_ALIGN_CENTER, 0, 24);

  lv_obj_add_flag(primeLayer, LV_OBJ_FLAG_HIDDEN);

  applyFlavorUi();
}

// ════════════════════════════════════════════════════════════
//  USB serial text commands (testing / diagnostics)
// ════════════════════════════════════════════════════════════

static void processTextLine(const char *line) {
  if (strcmp(line, "GET_VERSION") == 0) {
    Serial.printf("VERSION:FAUCET=%s\n", FW_VERSION);
  } else if (strcmp(line, "GET_STATE") == 0) {
    BaseLinkStatus link;
    baseLinkReadStatus(link);
    Serial.printf("STATE:FLAVOR=%d,SYNC=%d,BASE=%d,PERSISTED=%d,PENDING=%u,DURABILITYPENDING=%d,CACHEPENDING=%d,PRIME=%u,OWNER=%u\n",
                  activeFlavor, link.synchronized ? 1 : 0, link.mainBoardFlavor,
                  link.mainBoardPersisted ? 1 : 0, (unsigned)link.pending,
                  link.durabilityPending ? 1 : 0,
                  flavorDirty ? 1 : 0,
                  primeSessionKnown ? (unsigned)primeSession.phase : 0,
                  primeSessionKnown ? (unsigned)primeSession.owner : 0);
  } else if (strcmp(line, "GET_DIAG") == 0) {
    BaseLinkStatus link;
    baseLinkReadStatus(link);
    Serial.printf("DIAG:heap=%lu,minHeap=%lu,touchInts=%lu,toggles=%lu,"
                  "maxLoopMs=%lu,dim=%d,bl=%u,localPersistErr=%d,"
                  "base=%s,sync=%d,baseFlavor=%u,basePersisted=%d,basePersistErr=%d,durabilityPending=%d,"
                  "pending=%u,linkRx=%lu,linkTx=%lu,retries=%lu,qDrop=%lu,staleResp=%lu,truthSync=%lu,"
                  "lastAckMs=%lu,maxAckMs=%lu,maxLinkUs=%lu,primeQ=%u,primeDrop=%lu,"
                  "art=%u/%u,showing=%u,idle=%d,uptime=%lus\n",
                  (unsigned long)ESP.getFreeHeap(),
                  (unsigned long)ESP.getMinFreeHeap(),
                  (unsigned long)touch.intCount(),
                  (unsigned long)toggleCount,
                  (unsigned long)maxLoopMs, dimmed ? 1 : 0, blDuty,
                  flavorPersistError ? 1 : 0,
                  link.connected ? "up" : "down", link.synchronized ? 1 : 0,
                  (unsigned)link.mainBoardFlavor,
                  link.mainBoardPersisted ? 1 : 0,
                  link.mainBoardPersistError ? 1 : 0,
                  link.durabilityPending ? 1 : 0,
                  (unsigned)link.pending,
                  (unsigned long)link.framesRx, (unsigned long)link.framesTx,
                  (unsigned long)link.retries, (unsigned long)link.queueDrops,
                  (unsigned long)link.staleResponses,
                  (unsigned long)link.authoritativeReconciliations,
                  (unsigned long)link.lastAckMs, (unsigned long)link.maxAckMs,
                  (unsigned long)link.maxServiceUs,
                  (unsigned)link.primePending, (unsigned long)link.primeQueueDrops,
                  (unsigned)flavorArt[0], (unsigned)flavorArt[1],
                  (unsigned)flavorArt[activeFlavor & 1],
                  idleAsleepWanted ? 1 : 0,
                  millis() / 1000);
    Serial.printf("DIAG_PRIME:visible=%d,known=%d,phase=%u,owner=%u,outcome=%u,"
                  "pressed=%d,stop=%d,cancel=%d,lost=%d,session=%08lX,hold=%08lX,"
                  "revision=%lu,elapsed=%lu,epoch=%lu\n",
                  primeVisible ? 1 : 0, primeSessionKnown ? 1 : 0,
                  primeSessionKnown ? (unsigned)primeSession.phase : 0,
                  primeSessionKnown ? (unsigned)primeSession.owner : 0,
                  primeSessionKnown ? (unsigned)primeSession.outcome : 0,
                  primePressed ? 1 : 0, primeStopPending ? 1 : 0,
                  primeCancelPending ? 1 : 0, primeLinkLost ? 1 : 0,
                  (unsigned long)primeSession.sessionToken,
                  (unsigned long)primeHoldToken,
                  primeSessionKnown ? (unsigned long)primeSession.revision : 0,
                  primeSessionKnown ? (unsigned long)displayedPrimeElapsed() : 0,
                  (unsigned long)link.connectionGeneration);
    maxLoopMs = 0;  // high-water mark since last query
  } else if (strcmp(line, "TOGGLE") == 0) {
    selectFlavorLocally(activeFlavor ^ 1);
    Serial.printf("OK:FLAVOR=%d\n", activeFlavor);
  } else if (strncmp(line, "BL:", 3) == 0) {
    // Raw backlight poke (bring-up/demo). Holds until input or wake.
    const char *value = line + 3;
    char *end = nullptr;
    const long parsed = strtol(value, &end, 10);
    if (value[0] == '\0' || end == value || *end != '\0' || parsed < 0 || parsed > 255) {
      Serial.println("ERR:BL expects 0-255");
    } else {
      int duty = static_cast<int>(parsed);
      blDuty = blTarget = (uint8_t)duty;
      dimmed = duty < BL_FULL_DUTY;  // a tap on a poked-dim screen wakes, not toggles
      lastInputTime = millis();
      ledcWrite(LCD_BL, blDuty);
      Serial.printf("OK:BL=%d\n", duty);
    }
  } else if (strncmp(line, "FLAVOR:", 7) == 0) {
    const char *value = line + 7;
    char *end = nullptr;
    const long parsed = strtol(value, &end, 10);
    if (value[0] == '\0' || end == value || *end != '\0' || parsed < 0 || parsed > 1) {
      Serial.println("ERR:FLAVOR out of range");
    } else {
      const uint8_t f = static_cast<uint8_t>(parsed);
      selectFlavorLocally(f);
      Serial.printf("OK:FLAVOR=%d\n", activeFlavor);
    }
  } else {
    Serial.printf("ERR:unknown command '%s'\n", line);
  }
}

// ════════════════════════════════════════════════════════════
//  Setup / loop
// ════════════════════════════════════════════════════════════

void setup() {
  Serial.begin(115200);
  // Never block on USB writes: the HWCDC TX buffer only drains while a host
  // is reading the port. With the default 100ms timeout, every print stalls
  // the loop once the buffer fills — felt as tap lag. 0 = drop instead.
  Serial.setTxTimeoutMs(0);
  delay(500);
  Serial.println("ESP32-S3 Faucet Display starting...");

  esp_reset_reason_t reason = esp_reset_reason();
  Serial.printf("Boot — firmware %s, heap=%lu, reset=%d\n",
                FW_VERSION, (unsigned long)ESP.getFreeHeap(), (int)reason);

  // Persisted flavor selection
  flavorStoreOpen = prefs.begin("faucet");
  flavorPersistError = !flavorStoreOpen;
  activeFlavor = flavorStoreOpen ? prefs.getUChar("flavor", 0) : 0;
  if (activeFlavor > 1) {
    activeFlavor = 0;
    flavorDirty = true;
    flavorChangedAt = millis();
  }

  // Display hardware init
  if (!gfx->begin()) {
    Serial.println("gfx->begin() failed!");
  }
  lcdRegInit();
  gfx->setRotation(ROTATION);
  gfx->fillScreen(RGB565_BLACK);

  // Backlight on after the panel is initialized (avoids boot flash).
  // LEDC PWM so idle dimming can fade it.
  ledcAttach(LCD_BL, 5000, 8);
  ledcWrite(LCD_BL, blDuty);

  // Touch
  Wire.begin(TOUCH_SDA, TOUCH_SCL);
  touch.begin(Wire, ROTATION, gfx->width(), gfx->height());

  // LVGL init
  lv_init();
  lvgl_buf = (lv_color_t *)malloc(SCREEN_W * LVGL_BUF_LINES * sizeof(lv_color_t));
  if (!lvgl_buf) {
    Serial.println("FATAL: failed to allocate LVGL buffer!");
    while (1) delay(1000);
  }
  lv_disp_draw_buf_init(&draw_buf, lvgl_buf, NULL, SCREEN_W * LVGL_BUF_LINES);

  static lv_disp_drv_t disp_drv;
  lv_disp_drv_init(&disp_drv);
  disp_drv.hor_res = gfx->width();
  disp_drv.ver_res = gfx->height();
  disp_drv.flush_cb = lvglFlush;
  disp_drv.draw_buf = &draw_buf;
  lv_disp_drv_register(&disp_drv);

  static lv_indev_drv_t indev_drv;
  lv_indev_drv_init(&indev_drv);
  indev_drv.type = LV_INDEV_TYPE_POINTER;
  indev_drv.read_cb = touchpadRead;
  touchInput = lv_indev_drv_register(&indev_drv);

  buildUi();

  // P1 is the official Waveshare pinout: GPIO43 TX / GPIO44 RX. The main board's
  // J3 crosses them to IO35 RX / IO33 TX over the full-duplex TTL umbilical.
  primeTokenState = esp_random();
  if (primeTokenState == 0) primeTokenState = 1;
  baseLinkBegin(activeFlavor, acceptBaseFlavor, acceptBasePrime);

  lastInputTime = millis();
  Serial.printf("Ready — flavor %d (%s). Tap to switch.\n",
                activeFlavor + 1, FLAVOR_NAMES[activeFlavor]);
}

void loop() {
  unsigned long loopStart = millis();

  // USB serial commands (debug/test)
  static char usbBuf[64];
  static uint8_t usbPos = 0;
  while (Serial.available()) {
    char c = Serial.read();
    if (c == '\n' || c == '\r') {
      if (usbPos > 0) {
        usbBuf[usbPos] = '\0';
        processTextLine(usbBuf);
        usbPos = 0;
      }
    } else if (usbPos < sizeof(usbBuf) - 1) {
      usbBuf[usbPos++] = c;
    }
  }

  // RX before LVGL keeps main board reconciliation prompt. A second service
  // after LVGL transmits a touch-down selection without putting UART or NVS in
  // the touch callback itself.
  baseLinkService();
  BaseLinkStatus liveLink;
  baseLinkReadStatus(liveLink);
  primeService(liveLink);

  // Debounced flavor persist (off the tap path)
  if (flavorDirty && millis() - flavorChangedAt >= FLAVOR_PERSIST_DELAY_MS &&
      millis() - flavorPersistAttemptAt >= FLAVOR_PERSIST_DELAY_MS) {
    flavorPersistAttemptAt = millis();
    if (flavorStoreOpen && prefs.putUChar("flavor", activeFlavor) == sizeof(uint8_t)) {
      flavorDirty = false;
      flavorPersistError = false;
      Serial.printf("Cached main board flavor %d\n", activeFlavor + 1);
    } else {
      flavorPersistError = true;
      Serial.println("Faucet flavor cache write failed — main board remains authoritative");
    }
  }

  // Idle dimming: take the dim target when the appliance says both glasses are
  // done, then fade toward it. Waking snaps to full (wakeBacklight), so the
  // stepper only walks down. A live hold is this head's own business and holds
  // the dark off regardless.
  const bool primeRunning = primeSessionKnown && !primeLinkLost &&
                            primeSession.phase == PRIME_SESSION_RUNNING;
  if (!dimmed && idleAsleepWanted && !primePressed && !primeRunning) {
    dimmed = true;
    blTarget = BL_DIM_DUTY;
    Serial.println("Backlight dim (appliance idle)");
  }
  if (blDuty != blTarget) {
    int next = (int)blDuty - BL_FADE_STEP;
    if (next < (int)blTarget) next = blTarget;
    blDuty = (uint8_t)next;
    ledcWrite(LCD_BL, blDuty);
  }

  lv_timer_handler();
  baseLinkService();

  unsigned long loopMs = millis() - loopStart;
  if (loopMs > maxLoopMs) maxLoopMs = loopMs;

  delay(5);
}
